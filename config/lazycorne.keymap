#include <dt-bindings/zmk/outputs.h>
#include <behaviors.dtsi>
#include <dt-bindings/zmk/keys.h>

#define CONFIG_WIRELESS 1

#if CONFIG_WIRELESS
    #include <dt-bindings/zmk/bt.h>
    #define _BT_SEL_KEYS_ &bt BT_SEL 0 &bt BT_SEL 1 &bt BT_SEL 2 &bt BT_SEL 3 &bt BT_CLR
#else
    #define _BT_SEL_KEYS_ &trans &trans &trans &trans &trans
#endif

#define HOST_OS 1
#include "zmk-helpers/helper.h"
#include "zmk-helpers/key-labels/42.h"
#include "zmk-helpers/unicode-chars/greek.dtsi"
#include "zmk-helpers/unicode-chars/german.dtsi"

/* layer and key shortcuts */
#define DEF 0
#define NAV 1
#define FN 2
#define NUM 3
#define SYS 4
#define UC 5
#define MOUSE 6
#define MOUSEVS 7
#define MOUSEHS 8

#include "mouse.dtsi"
#include "combos.dtsi"

#define XXX &none
#define ___ &trans


/* Global settings */

#define QUICK_TAP_MS 175

/{
  cirque_mmv {
    compatible = "zmk,input-behavior-listener";
    device = <&vtrackpad>;
    layers= <DEF MOUSE>;
    evt-type = <INPUT_EV_REL>;
    x-input-code = <INPUT_REL_X>;
    y-input-code = <INPUT_REL_Y>;
    scale-multiplier = <2>;
    scale-divisor = <1>;
    bindings = <&ib_tog_layer MOUSE>;
    y-invert;
  }; 
  cirque_scl {
    compatible = "zmk,input-behavior-listener";
    device = <&vtrackpad>;
    layers = <MOUSEVS>;
    evt-type = <INPUT_EV_REL>;
    
    /* slienting x-axis with alt event code */
    x-input-code = <INPUT_REL_MISC>;
    y-input-code = <INPUT_REL_WHEEL>;

    /* invent scrolling direction */
    y-invert;
    bindings = <&ib_wheel_scaler 1 16>;
  };
  cirque_hscl {
    compatible = "zmk,input-behavior-listener";
    device = <&vtrackpad>;
    layers = <MOUSEHS>;
    evt-type = <INPUT_EV_REL>;
    
    /* slienting x-axis with alt event code */
    x-input-code = <INPUT_REL_HWHEEL>;
    y-input-code = <INPUT_REL_MISC>;

    /* invent scrolling direction */
    // y-invert;
    x-invert;
    bindings = <&ib_hwheel_scaler 1 16>;
  };
  // 아직 기능이 완벽하지 않음 터치를 하는동안 인식하는것이 아니라 움직임이 나타나야 인지함
  ib_tog_layer: ib_tog_layer {
    compatible = "zmk,input-behavior-tog-layer";
    #binding-cells = <1>;
    time-to-live-ms = <2500>;
  };
  ib_wheel_scaler: ib_wheel_scaler {
    compatible = "zmk,input-behavior-scaler";
    #binding-cells = <2>;
    evt-type = <INPUT_EV_REL>;
    input-code = <INPUT_REL_WHEEL>;
  };

  ib_hwheel_scaler: ib_hwheel_scaler {
    compatible = "zmk,input-behavior-scaler";
    #binding-cells = <2>;
    evt-type = <INPUT_EV_REL>;
    input-code = <INPUT_REL_HWHEEL>;
  };
  
};


&sk {  // sticky-key config
    release-after-ms = <900>;  // release after 0.6s
    quick-release;             // no double capitalization when rolling keys
};

&sl {  // sticky-layer config
    ignore-modifiers;          // allow chording sticky mods & layers
};

&lt {  // layer-tap config
    flavor = "balanced";
    tapping-term-ms = <200>;
    quick-tap-ms = <QUICK_TAP_MS>;
};

/* Homerow mods */
#define KEYS_L LT0 LT1 LT2 LT3 LT4 LT5 LM0 LM1 LM2 LM3 LM4 LM5 LB0 LB1 LB2 LB3 LB4 LB5  // left hand
#define KEYS_R RT0 RT1 RT2 RT3 RT4 RT5 RM0 RM1 RM2 RM3 RM4 RM5 RB0 RB1 RB2 RB3 RB4 RB5 // right hand
#define THUMBS LH2 LH1 LH0 RH0 RH1 RH2                                      // thumbs

/* left-hand HRMs */
#define MAKE_HRM(NAME, HOLD, TAP, TRIGGER_POS) \
    ZMK_HOLD_TAP(NAME, \
        flavor = "balanced"; \
        tapping-term-ms = <280>; \
        quick-tap-ms = <QUICK_TAP_MS>; \
        require-prior-idle-ms = <100>; \
        bindings = <HOLD>, <TAP>; \
        hold-trigger-key-positions = <TRIGGER_POS>; \
        hold-trigger-on-release; \
    )
MAKE_HRM(hml, &kp, &kp, KEYS_R THUMBS)  // left-hand HRMs
MAKE_HRM(hmr, &kp, &kp, KEYS_L THUMBS)  // right-hand HRMs
MAKE_HRM(hml_def, &kp, &to, KEYS_R THUMBS)

MAKE_HRM(hml_repeat,  &kp, &key_repeat, KEYS_R THUMBS)  // used for HRM-combo
MAKE_HRM(hmr_lpar_lt, &kp, &lpar_lt, KEYS_L THUMBS)    // "    "   "   "
MAKE_HRM(hmr_rpar_gt, &kp, &rpar_gt, KEYS_L THUMBS)    // "    "   "   "


#define MT_CORE \
    flavor = "tap-preferred"; \
    tapping-term-ms = <220>; \
    quick-tap-ms = <220>; \
    hold-trigger-key-positions = <0>;

&mt { MT_CORE };
ZMK_HOLD_TAP(mt_home, bindings = <&masked_home>, <&kp>; MT_CORE)
ZMK_HOLD_TAP(mt_end, bindings = <&masked_end>, <&kp>; MT_CORE)

#define ESCLT &lt NAV ESC
#define SPCLT &lt FN SPC

#define NAV_LEFT  &mt_home 0   LEFT    // tap: left  | long-tap: beginning of line
#define NAV_RIGHT &mt_end 0    RIGHT   // tap: right | long-tap: end       of line
#define NAV_UP    &mt LC(HOME) UP      // tap: up    | long-tap: beginning of document
#define NAV_DOWN  &mt LC(END)  DOWN    // tap: down  | long-tap: end       of document
/* #define NAV_BSPC  &mt LC(BSPC) BSPC    // tap: bspc  | long-tap: delete word backward */
/* #define NAV_DEL   &mt LC(DEL)  DEL     // tap: del   | long-tap: delete word forward */

// mask CTRL when holding left/right to avoid accidental jumps to beginning/end of document
#define MASK_MODS(NAME, MODS, BINDING) \
    ZMK_MOD_MORPH(NAME, \
        bindings = <BINDING>, <BINDING>; \
        mods = <MODS>; \
    )
MASK_MODS(masked_home, (MOD_LCTL), &kp HOME)
MASK_MODS(masked_end,  (MOD_LCTL), &kp END)

/* Caps-word, num-word and smart-mouse */

// tap: sticky-shift | shift + tap/ double-tap: caps-word | hold: shift
ZMK_MOD_MORPH(smart_shft,
    bindings = <&sk LSHFT>, <&caps_word>;
    mods = <(MOD_LSFT)>;
)
&caps_word {  // mods deactivate caps-word, requires PR #1451
    /delete-property/ ignore-modifiers;
};

// tap: num-word | double-tap: sticky num-layer | hold: num-layer
#define SMART_NUM &smart_num NUM 0

ZMK_HOLD_TAP(smart_num,
    flavor = "balanced";
    tapping-term-ms = <200>;
    quick-tap-ms = <QUICK_TAP_MS>;
    bindings = <&mo>, <&num_dance>;
)
ZMK_TAP_DANCE(num_dance,
    tapping-term-ms = <200>;
    bindings = <&num_word>, <&sl NUM>;  // reverse this for sticky-num on single tap
)
&num_word {  // num-word, requires PR #1451
    layers = <NUM>;
    continue-list = <BSPC DEL DOT COMMA PLUS KP_PLUS KP_MINUS MINUS STAR FSLH EQUAL>;
};

// smart-mouse, requires PR #1366
ZMK_TRI_STATE(smart_mouse,
    bindings = <&ib_tog_layer MOUSE>, <&ib_tog_layer MOUSE>, <&to DEF>;
    ignored-key-positions = <LT1 LT2 LM1 LM2 LM3 LM4 LH0 LH1 LH2>;
    ignored-layers = <MOUSE MOUSEVS MOUSEHS>;
)

/* Custom behaviors */

// Alt+Tab swapper, requires PR #1366
ZMK_TRI_STATE(swapper,
    bindings = <&kt LALT>, <&kp TAB>, <&kt LALT>;
    ignored-key-positions = <LT2>;
)

// Sticky layer + sticky shift (workaround for issue #1421)
ZMK_STICKY_KEY(sls,
    release-after-ms = <1000>;
    bindings = <&uc_shift>;
    ignore-modifiers;
)
ZMK_MACRO(uc_shift,
    wait-ms = <0>;
    tap-ms = <1>;
    bindings = <&macro_press &mo UC &kp LSHFT>
             , <&macro_pause_for_release>
             , <&macro_release &mo UC &kp LSHFT>;
)


ZMK_MACRO(tog_mousev,
    wait-ms = <0>;
    tap-ms = <1>;
    bindings = <&smart_mouse>
             , <&macro_press &mo MOUSEVS>
             , <&macro_pause_for_release>
             , <&macro_release &mo MOUSEVS>;
)

ZMK_MACRO(tog_mouseh,
    wait-ms = <0>;
    tap-ms = <1>;
    bindings = <&smart_mouse>
             , <&macro_press &mo MOUSEHS>
             , <&macro_pause_for_release>
             , <&macro_release &mo MOUSEHS>;
)

ZMK_HOLD_TAP(tog_msv, 
    flavor = "balanced";
    tapping-term-ms = <200>;
    quick-tap-ms = <QUICK_TAP_MS>;
    bindings = <&tog_mousev>, <&kp>;
)

ZMK_HOLD_TAP(tog_msh,
    flavor = "balanced";
    tapping-term-ms = <200>;
    quick-tap-ms = <QUICK_TAP_MS>;
    bindings = <&tog_mouseh>, <&kp>;
)


// reuse basic mod-morph scheme
#define SIMPLE_MORPH(NAME, MOD, BINDING1, BINDING2) \
    ZMK_MOD_MORPH(NAME, \
        mods = <(MOD_L ## MOD|MOD_R ## MOD)>; \
        bindings = <BINDING1>, <BINDING2>; \
    )

// tap: comma | shift + tap: semicolon | ctrl + shift + tap: <
SIMPLE_MORPH(comma_morph, SFT, &kp COMMA, &comma_inner_morph)
SIMPLE_MORPH(comma_inner_morph, CTL, &kp SEMICOLON, &kp LESS_THAN)

// tap: dot | shift + tap: colon | ctrl + shift + tap: >
SIMPLE_MORPH(dot_morph, SFT, &kp DOT, &dot_inner_morph)
SIMPLE_MORPH(dot_inner_morph, CTL, &kp COLON, &kp GREATER_THAN)

// tap: qmark | shift + tap: excl
SIMPLE_MORPH(qexcl, SFT, &kp QMARK, &kp EXCL)

// tap: left/right parenthesis | shft + tap: less-than/greater-than
SIMPLE_MORPH(lpar_lt, SFT, &kp LPAR, &kp LT)
SIMPLE_MORPH(rpar_gt, SFT, &kp RPAR, &kp GT)

// tap: space | shift + tap: dot -> space -> sticky shift | hold: activate layer
ZMK_HOLD_TAP(lt_spc,
    flavor = "balanced";
    tapping-term-ms = <200>;
    quick-tap-ms = <QUICK_TAP_MS>;
    bindings = <&mo>, <&spc_morph>;
)

ZMK_HOLD_TAP(togt,
    flavor = "balanced";
    tapping-term-ms = <200>;
    quick-tap-ms = <QUICK_TAP_MS>;
    bindings = <&tog>, <&kp>;
)


ZMK_HOLD_TAP(mt_esc,
             flavor = "hold-preferred";
             tapping-term-ms = <125>;
             quick-tap-ms = <125>;
             bindings = <&kp>, <&kp>;
)


ZMK_HOLD_TAP(hml_sk,
            flavor="balanced";
            tapping-term-ms=<125>;
            quick-tap-ms = <125>;
            bindings = <&kp>, <&sk>;
)

#define ESCM &mt_esc LCTRL ESC

SIMPLE_MORPH(spc_morph, SFT, &kp SPACE, &dot_spc)

ZMK_MACRO(dot_spc,
    wait-ms = <0>;
    tap-ms = <5>;
    bindings = <&kp DOT &kp SPACE &sk LSHFT>;
)

// tap: backspace | lshft + tap: delete | rshft + tap: shift-delete
ZMK_MOD_MORPH(bs_del,
    bindings = <&kp BSPC>, <&kp DEL>;
    mods = <(MOD_LSFT|MOD_RSFT)>;
    keep-mods = <MOD_RSFT>;
)

// tap: copy | double-tap: cut
ZMK_TAP_DANCE(copy_cut,
    tapping-term-ms = <200>;
    bindings = <&kp LC(LS(C))>, <&kp LC(LS(X))>;
)
// Windows sleep key
ZMK_MACRO(win_sleep,
    wait-ms = <500>;
    tap-ms = <50>;
    bindings = <&kp LG(X) &kp U &kp S>;
)

// misc aliases
#define CANCEL      &kp K_CANCEL             // cancel caps-word, num-word and smart-mouse
#define DSK_PREV    &hmr LCTRL LG(LC(LEFT))   // previous desktop
#define DSK_NEXT    &hmr LALT LG(LC(RIGHT)) // next     desktop
#define PIN_WIN     &kp LG(LC(LS(Q)))        // pin window across desktops
#define PIN_APP     &kp LG(LC(LS(A)))        // pin application across desktops
#define DSK_MGR     &kp LA(GRAVE)            // desktop manager
#define VOL_DOWN    &hmr LSHFT C_VOL_DN
#define LANG_CANGE  &kp LC(SPC)

#define SK_A &hml_sk LGUI LGUI 
#define SK_S &hml_sk LALT LALT
#define SK_D &hml_sk LSHFT LSHFT
#define SK_F &hml_sk LCTRL LCTRL
#define KP0 &lt NAV N0

/* Keymap */

ZMK_CONDITIONAL_LAYER(FN NUM, SYS)  // FN + NUM --> SYS
// ZMK_CONDITIONAL_LAYER(NAV FN, MOUSE)  // FN + NUM --> SYS

/* keymap */

ZMK_LAYER(base,
     // ╭──────────────┬──────────────┬──────────────┬──────────────┬──────────────┬──────────────╮   ╭──────────────┬──────────────┬──────────────┬──────────────┬──────────────┬──────────────╮
         &kp TAB        &kp Q          &kp W          &tog_msh 0 E   &tog_msv 0 R   &kp T              &kp Y          &kp U          &kp I          &kp O          &kp P          &bs_del
     // ├──────────────┼──────────────┼──────────────┼──────────────┼──────────────┼──────────────┤   ├──────────────┼──────────────┼──────────────┼──────────────┼──────────────┼──────────────┤
         ESCM           &hml LGUI A    &hml LALT S    &hml LSHFT D   &hml LCTRL F   &kp G              &kp H          &hmr LCTRL J   &hmr LSHFT K   &hmr LALT L    &hmr LGUI SQT  &kp LANG1
     // ├──────────────┼──────────────┼──────────────┼──────────────┼──────────────┼──────────────┤   ├──────────────┼──────────────┼──────────────┼──────────────┼──────────────┼──────────────┤
         &kp LGUI       &kp Z          &kp X          &kp C          &kp V          &kp B              &kp N          &kp M          &comma_morph   &dot_morph     &qexcl         &kp LALT
     // ╰──────────────┴──────────────┴──────────────┼──────────────┼──────────────┼──────────────┤   ├──────────────┼──────────────┼──────────────┼──────────────┴──────────────┴──────────────╯
                                                      &smart_shft    &mo NAV        &lt_spc FN 0       &kp RET        SMART_NUM      &smart_shft 
     //                                              ╰──────────────┴──────────────┴──────────────╯   ╰──────────────┴──────────────┴──────────────╯
)


ZMK_LAYER(nav,
     // ╭──────────────┬──────────────┬──────────────┬──────────────┬──────────────┬──────────────╮   ╭──────────────┬──────────────┬──────────────┬──────────────┬──────────────┬──────────────╮
         ___            ___            ___            &kp LS(TAB)    &swapper       ___                ___            ___            ___            ___            &kp PG_UP      ___
     // ├──────────────┼──────────────┼──────────────┼──────────────┼──────────────┼──────────────┤   ├──────────────┼──────────────┼──────────────┼──────────────┼──────────────┼──────────────┤
         ___            SK_A           SK_S           SK_D           SK_F           ___                NAV_LEFT       NAV_DOWN       NAV_UP         NAV_RIGHT      &kp PG_DN      ___
     // ├──────────────┼──────────────┼──────────────┼──────────────┼──────────────┼──────────────┤   ├──────────────┼──────────────┼──────────────┼──────────────┼──────────────┼──────────────┤
         ___            ___            ___            ___            ___            ___                &kp INS        ___            &kp LT         &kp GT         ___            ___
     // ╰──────────────┴──────────────┴──────────────┼──────────────┼──────────────┼──────────────┤   ├──────────────┼──────────────┼──────────────┼──────────────┴──────────────┴──────────────╯
                                                      ___            ___            ___                ___            ___            CANCEL 
     //                                              ╰──────────────┴──────────────┴──────────────╯   ╰──────────────┴──────────────┴──────────────╯
)

ZMK_LAYER(fn,
     // ╭──────────────┬──────────────┬──────────────┬──────────────┬──────────────┬──────────────╮   ╭──────────────┬──────────────┬──────────────┬──────────────┬──────────────┬──────────────╮
         ___            ___            &kp F7         &kp F8         &kp F9         &kp F10            ___            &kp C_VOL_UP   &kp C_BRI_UP   ___            &kp PSCRN      ___
     // ├──────────────┼──────────────┼──────────────┼──────────────┼──────────────┼──────────────┤   ├──────────────┼──────────────┼──────────────┼──────────────┼──────────────┼──────────────┤
         ___            ___            &hml LALT F4   &hml LSHFT F5  &hml LCTRL F6  &kp F11            ___            &kp C_VOL_DN   &kp C_BRI_DN   ___            ___            ___
     // ├──────────────┼──────────────┼──────────────┼──────────────┼──────────────┼──────────────┤   ├──────────────┼──────────────┼──────────────┼──────────────┼──────────────┼──────────────┤
         ___            ___            &kp F1         &kp F2         &kp F3         &kp F12            ___            &kp C_MUTE     &kp C_PREV     &kp C_NEXT     &kp C_PP       ___
     // ╰──────────────┴──────────────┴──────────────┼──────────────┼──────────────┼──────────────┤   ├──────────────┼──────────────┼──────────────┼──────────────┴──────────────┴──────────────╯
                                                      ___            ___            ___                ___            ___            ___ 
     //                                              ╰──────────────┴──────────────┴──────────────╯   ╰──────────────┴──────────────┴──────────────╯
)

ZMK_LAYER(num,
     // ╭──────────────┬──────────────┬──────────────┬──────────────┬──────────────┬──────────────╮   ╭──────────────┬──────────────┬──────────────┬──────────────┬──────────────┬──────────────╮
         ___            ___            &kp N7         &kp N8         &kp N9         ___                ___            ___            ___            ___            ___            ___
     // ├──────────────┼──────────────┼──────────────┼──────────────┼──────────────┼──────────────┤   ├──────────────┼──────────────┼──────────────┼──────────────┼──────────────┼──────────────┤
         ___            ___            &hml LALT N4   &hml LSHFT N5  &hml LCTRL N6  ___                ___            ___            ___            ___            ___            ___
     // ├──────────────┼──────────────┼──────────────┼──────────────┼──────────────┼──────────────┤   ├──────────────┼──────────────┼──────────────┼──────────────┼──────────────┼──────────────┤
         ___            ___            &kp N1         &kp N2         &kp N3         ___                ___            ___            ___            ___            ___            ___
     // ╰──────────────┴──────────────┴──────────────┼──────────────┼──────────────┼──────────────┤   ├──────────────┼──────────────┼──────────────┼──────────────┴──────────────┴──────────────╯
                                                      ___            KP0            ___                ___            ___            ___ 
     //                                              ╰──────────────┴──────────────┴──────────────╯   ╰──────────────┴──────────────┴──────────────╯
)

ZMK_LAYER(sys,
     // ╭──────────────┬──────────────┬──────────────┬──────────────┬──────────────┬──────────────╮   ╭──────────────┬──────────────┬──────────────┬──────────────┬──────────────┬──────────────╮
         ___                                    _BT_SEL_KEYS_                                          ___            ___            ___            ___            ___            ___
     // ├──────────────┼──────────────┼──────────────┼──────────────┼──────────────┼──────────────┤   ├──────────────┼──────────────┼──────────────┼──────────────┼──────────────┼──────────────┤
         ___            ___            ___            ___            ___            &bootloader        &bootloader    &out OUT_TOG   ___            ___            ___            ___
     // ├──────────────┼──────────────┼──────────────┼──────────────┼──────────────┼──────────────┤   ├──────────────┼──────────────┼──────────────┼──────────────┼──────────────┼──────────────┤
         ___            ___            ___            ___            ___            &sys_reset         &sys_reset     ___            ___            ___            ___            ___
     // ╰──────────────┴──────────────┴──────────────┼──────────────┼──────────────┼──────────────┤   ├──────────────┼──────────────┼──────────────┼──────────────┴──────────────┴──────────────╯
                                                      ___            ___            ___                ___            ___            ___
     //                                              ╰──────────────┴──────────────┴──────────────╯   ╰──────────────┴──────────────┴──────────────╯
)

// ZMK_LAYER(uc,
//      // ╭──────────────┬──────────────┬──────────────┬──────────────┬──────────────┬──────────────╮   ╭──────────────┬──────────────┬──────────────┬──────────────┬──────────────┬──────────────╮
//          ___            ___            &el_omega      &el_phi        &el_pi         &el_beta           ___            &el_lambda     &el_upsilon    &el_psi        &de_eszett     ___
//      // ├──────────────┼──────────────┼──────────────┼──────────────┼──────────────┼──────────────┤   ├──────────────┼──────────────┼──────────────┼──────────────┼──────────────┼──────────────┤
//          ___            &el_alpha      &el_rho        &el_sigma      &el_tau        &el_gamma          &el_mu         &el_nu         &el_epsilon    &el_iota       &el_omikron    ___
//      // ├──────────────┼──────────────┼──────────────┼──────────────┼──────────────┼──────────────┤   ├──────────────┼──────────────┼──────────────┼──────────────┼──────────────┼──────────────┤
//          ___            &el_zeta       &el_xi         &el_chi        &el_delta      &el_theta          &el_kappa      &el_eta        &de_ae         &de_oe         &de_ue         ___
//      // ╰──────────────┴──────────────┴──────────────┼──────────────┼──────────────┼──────────────┤   ├──────────────┼──────────────┼──────────────┼──────────────┴──────────────┴──────────────╯
//                                                       ___            ___            ___                ___            ___            ___ 
//      //                                              ╰──────────────┴──────────────┴──────────────╯   ╰──────────────┴──────────────┴──────────────╯
// )

ZMK_LAYER(uc,
     // ╭──────────────┬──────────────┬──────────────┬──────────────┬──────────────┬──────────────╮   ╭──────────────┬──────────────┬──────────────┬──────────────┬──────────────┬──────────────╮
         ___            ___            &el_omega      &el_epsilon    &el_rho        &el_tau            &el_psi        &el_upsilon    &el_iota       &el_omikron    &el_pi         ___
     // ├──────────────┼──────────────┼──────────────┼──────────────┼──────────────┼──────────────┤   ├──────────────┼──────────────┼──────────────┼──────────────┼──────────────┼──────────────┤
         ___            &el_alpha      &el_sigma      &el_delta      &el_phi        &el_gamma          &el_eta        ___            &el_kappa      &el_lambda     &de_eszett     ___
     // ├──────────────┼──────────────┼──────────────┼──────────────┼──────────────┼──────────────┤   ├──────────────┼──────────────┼──────────────┼──────────────┼──────────────┼──────────────┤
         ___            &el_zeta       &el_xi         &el_chi        &el_delta      &el_theta          &el_nu         &el_mu         &de_ae         &de_oe         &de_ue         ___
     // ╰──────────────┴──────────────┴──────────────┼──────────────┼──────────────┼──────────────┤   ├──────────────┼──────────────┼──────────────┼──────────────┴──────────────┴──────────────╯
                                                      ___            ___            ___                ___            ___            ___ 
     //                                              ╰──────────────┴──────────────┴──────────────╯   ╰──────────────┴──────────────┴──────────────╯
)

ZMK_LAYER(mouse,
     // ╭──────────────┬──────────────┬──────────────┬──────────────┬──────────────┬──────────────╮   ╭──────────────┬──────────────┬──────────────┬──────────────┬──────────────┬──────────────╮
         ___            ___            ___            &mo MOUSEHS    &mo MOUSEVS    ___                ___            ___            ___            ___            ___            ___
     // ├──────────────┼──────────────┼──────────────┼──────────────┼──────────────┼──────────────┤   ├──────────────┼──────────────┼──────────────┼──────────────┼──────────────┼──────────────┤
         ___            &kp LGUI       &kp LALT       &kp LSHFT      &kp LCTRL      ___                ___            ___            ___            ___            ___            ___
     // ├──────────────┼──────────────┼──────────────┼──────────────┼──────────────┼──────────────┤   ├──────────────┼──────────────┼──────────────┼──────────────┼──────────────┼──────────────┤
         ___            ___            ___            ___            ___            ___                ___            ___            ___            ___            ___            ___
     // ╰──────────────┴──────────────┴──────────────┼──────────────┼──────────────┼──────────────┤   ├──────────────┼──────────────┼──────────────┼──────────────┴──────────────┴──────────────╯
                                                      &mkp MCLK      &mkp RCLK      &mkp LCLK          ___            ___            ___ 
     //                                              ╰──────────────┴──────────────┴──────────────╯   ╰──────────────┴──────────────┴──────────────╯
)

ZMK_LAYER(mouse_vs,
     // ╭──────────────┬──────────────┬──────────────┬──────────────┬──────────────┬──────────────╮   ╭──────────────┬──────────────┬──────────────┬──────────────┬──────────────┬──────────────╮
         ___            ___            ___            ___            ___            ___                ___            ___            ___            ___            ___            ___
     // ├──────────────┼──────────────┼──────────────┼──────────────┼──────────────┼──────────────┤   ├──────────────┼──────────────┼──────────────┼──────────────┼──────────────┼──────────────┤
         ___            ___            ___            ___            ___            ___                ___            ___            ___            ___            ___            ___
     // ├──────────────┼──────────────┼──────────────┼──────────────┼──────────────┼──────────────┤   ├──────────────┼──────────────┼──────────────┼──────────────┼──────────────┼──────────────┤
         ___            ___            ___            ___            ___            ___                ___            ___            ___            ___            ___            ___
     // ╰──────────────┴──────────────┴──────────────┼──────────────┼──────────────┼──────────────┤   ├──────────────┼──────────────┼──────────────┼──────────────┴──────────────┴──────────────╯
                                                      ___            ___            ___                ___            ___            ___ 
     //                                              ╰──────────────┴──────────────┴──────────────╯   ╰──────────────┴──────────────┴──────────────╯
)

ZMK_LAYER(mouse_hs,
     // ╭──────────────┬──────────────┬──────────────┬──────────────┬──────────────┬──────────────╮   ╭──────────────┬──────────────┬──────────────┬──────────────┬──────────────┬──────────────╮
         ___            ___            ___            ___            ___            ___                ___            ___            ___            ___            ___            ___
     // ├──────────────┼──────────────┼──────────────┼──────────────┼──────────────┼──────────────┤   ├──────────────┼──────────────┼──────────────┼──────────────┼──────────────┼──────────────┤
         ___            ___            ___            ___            ___            ___                ___            ___            ___            ___            ___            ___
     // ├──────────────┼──────────────┼──────────────┼──────────────┼──────────────┼──────────────┤   ├──────────────┼──────────────┼──────────────┼──────────────┼──────────────┼──────────────┤
         ___            ___            ___            ___            ___            ___                ___            ___            ___            ___            ___            ___
     // ╰──────────────┴──────────────┴──────────────┼──────────────┼──────────────┼──────────────┤   ├──────────────┼──────────────┼──────────────┼──────────────┴──────────────┴──────────────╯
                                                      ___            ___            ___                ___            ___            ___ 
     //                                              ╰──────────────┴──────────────┴──────────────╯   ╰──────────────┴──────────────┴──────────────╯
)

// &usbd {
// 	status = "okay";
// 	cdc_acm_uart: cdc_acm_uart {
// 		compatible = "zephyr,cdc-acm-uart";
// 		label = "CDC_ACM_0";
// 	};
// };
