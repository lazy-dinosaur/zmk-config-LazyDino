## boards/shields/lazycorne/Kconfig.defconfig
```kconfig
# Copyright (c) 2020 The ZMK Contributors
# SPDX-License-Identifier: MIT

if SHIELD_LAZYCORNE_DONGLE

config ZMK_KEYBOARD_NAME
	default "LazyCorne"
	
config ZMK_SPLIT_BLE_ROLE_CENTRAL
	default y
	
config ZMK_USB
	default y

endif

if SHIELD_LAZYCORNE_LEFT || SHIELD_LAZYCORNE_RIGHT || SHIELD_LAZYCORNE_DONGLE 

config ZMK_SPLIT
	default y

config ZMK_BLE
	default y
	
endif
```

## boards/shields/lazycorne/Kconfig.shield
```kconfig
# Copyright (c) 2020 The ZMK Contributors
# SPDX-License-Identifier: MIT

config SHIELD_LAZYCORNE_LEFT
	def_bool $(shields_list_contains,lazycorne_left)

config SHIELD_LAZYCORNE_RIGHT
	def_bool $(shields_list_contains,lazycorne_right)

config SHIELD_LAZYCORNE_DONGLE
	def_bool $(shields_list_contains,lazycorne_dongle)
```

## config/Kconfig.defConfig
```kconfig
if SHIELD_CORNE_RIGHT

config ZMK_KEYBOARD_NAME
    default "Corne"

config ZMK_SPLIT_ROLE_CENTRAL
    default y

endif

if SHIELD_CORNE_LEFT || SHIELD_CORNE_RIGHT

config ZMK_SPLIT
    default y

if LVGL

config LV_Z_VDB_SIZE
    default 64

config LV_Z_DPI
    default 148

config LV_Z_BITS_PER_PIXEL
    default 1

choice LV_COLOR_DEPTH
    default LV_COLOR_DEPTH_1
endchoice

endif # LVGL

endif
```

## config/west.yml
```yaml
manifest:
  defaults:
    remote: urob
    revision: v0.1 # Pin everything to v0.1

  remotes:
    - name: urob
      url-base: https://github.com/urob
    - name: zmkfirmware
      url-base: https://github.com/zmkfirmware
    - name: petejohanson

      url-base: https://github.com/petejohanson
    - name: urob
      url-base: https://github.com/urob
    - name: badjeff
      url-base: https://github.com/badjeff
    - name: lazy-dinosaur
      url-base: https://github.com/lazy-dinosaur

  projects:
    # This is vanilla ZMK - just using my remote to pin the current state of main,
    # as upstream hasn't yet released a version with mouse.
    - name: zmk
      revision: v0.1+mouse
      import: app/west.yml

    # ZMK modules
    - name: zmk-adaptive-key
      path: modules/zmk/adaptive-key
    - name: zmk-auto-layer
      path: modules/zmk/auto-layer
    - name: zmk-leader-key
      revision: v0.1+locality
      path: modules/zmk/leader-key
    - name: zmk-tri-state
      path: modules/zmk/tri-state
    - name: cirque-input-module
      remote: petejohanson
      revision: main
    - name: zmk-helpers
      remote: urob
      revision: v2 # t
    - name: zmk-input-behavior-listener
      remote: badjeff
      revision: main
    - name: zmk-split-peripheral-input-relay
      remote: badjeff
      revision: main
    - name: zmk-config-LazyDino
      remote: lazy-dinosaur
      revision: master

    # Temporarily overload Zephyr until
    # https://github.com/zmkfirmware/zephyr/pull/40 is merged.
    - name: zephyr
      revision: v3.5.0+zmk-fixes
      clone-depth: 1
      import:
        name-blocklist:
          - ci-tools
          - hal_altera
          - hal_cypress
          - hal_infineon
          - hal_microchip
          - hal_nxp
          - hal_openisa
          - hal_silabs
          - hal_xtensa
          - hal_st
          - hal_ti
          - loramac-node
          - mcuboot
          - mcumgr
          - net-tools
          - openthread
          - edtt
          - trusted-firmware-m

  self:
    path: config
```
